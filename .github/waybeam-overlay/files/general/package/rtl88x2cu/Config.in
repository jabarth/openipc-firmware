## .github/waybeam-overlay/files/general/package/rtl88x2cu/Config.in
```kconfig
config BR2_PACKAGE_RTL88X2CU
	bool "rtl88x2cu (OpenHD fork)"
	depends on BR2_LINUX_KERNEL
	help
	  Realtek 8812cu / 8822cu Wi-Fi driver.
	  Uses the OpenHD fork (github.com/OpenHD/rtl88x2cu) which produces
	  8812cu_ohd.ko with working monitor mode support for FPV.
```
