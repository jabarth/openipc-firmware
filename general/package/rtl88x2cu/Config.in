## general/package/rtl88x2cu/Config.in
```kconfig
config BR2_PACKAGE_RTL88X2CU
	bool "rtl88x2cu"
	depends on BR2_LINUX_KERNEL
	help
	  Realtek 8812cu / 8822cu Wi-Fi driver.
	  Uses the libc0607 fork optimized for FPV/OpenIPC.
```

## general/package/waybeam_venc/Config.in
```kconfig
config BR2_PACKAGE_WAYBEAM_VENC
	bool "waybeam_venc"
	help
	  Waybeam Video Encoder streaming service for OpenIPC.
```
